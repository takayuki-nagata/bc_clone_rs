## CMakeLists.txt
```
# Copyright (c) 2026 Takayuki Nagata
# SPDX-License-Identifier: MIT

cmake_minimum_required(VERSION 3.20.0)

find_package(Zephyr REQUIRED HINTS $ENV{ZEPHYR_BASE})
project(bc_zephyr_app)

if(NOT DEFINED RUST_TARGET)
    if(CONFIG_BOARD_STAMP_C3 OR CONFIG_SOC_ESP32C3 OR CONFIG_SOC_SERIES_ESP32C3 OR NOT CONFIG_RISCV_ISA_EXT_A)
        set(RUST_TARGET riscv32imc-unknown-none-elf)
    else()
        set(RUST_TARGET riscv32imac-unknown-none-elf)
    endif()
endif()

get_filename_component(BC_REPO_ROOT "${CMAKE_CURRENT_SOURCE_DIR}/../.." ABSOLUTE)
set(BC_ZEPHYR_DIR "${BC_REPO_ROOT}/crates/bc_zephyr")
set(RUST_LIB_DIR "${BC_REPO_ROOT}/target/${RUST_TARGET}/release")
set(RUST_LIB "${RUST_LIB_DIR}/libbc_zephyr.a")

# Automatically invoke Cargo to build Rust staticlib during Zephyr build
add_custom_command(
    OUTPUT ${RUST_LIB}
    COMMAND cargo build --release --target ${RUST_TARGET} --no-default-features --manifest-path "${BC_ZEPHYR_DIR}/Cargo.toml"
    WORKING_DIRECTORY ${BC_ZEPHYR_DIR}
    COMMENT "Building bc_zephyr staticlib for Zephyr target (${RUST_TARGET})..."
)

add_custom_target(bc_zephyr_staticlib DEPENDS ${RUST_LIB})

target_sources(app PRIVATE src/main.c)
add_dependencies(app bc_zephyr_staticlib)
target_link_libraries(app PRIVATE ${RUST_LIB})
```

## Kconfig
```
# Copyright (c) 2026 Takayuki Nagata
# SPDX-License-Identifier: MIT

config BC_QEMU_REPL
	bool "Start the interactive REPL on QEMU"
	help
	  On qemu_riscv32 the application normally runs the self-tests and then
	  exits QEMU through the SiFive test device, which CI relies on. With this
	  option it runs the self-tests and then starts the interactive REPL on the
	  serial console, as it does on hardware.

source "Kconfig.zephyr"
```

## prj.conf
```kconfig
# Copyright (c) 2026 Takayuki Nagata
# SPDX-License-Identifier: MIT

# Zephyr Kernel Console Configuration
CONFIG_PRINTK=y
CONFIG_CONSOLE=y
CONFIG_UART_CONSOLE=y
CONFIG_SERIAL=y

# Memory & Stack Size Configuration for Arbitrary-Precision Math
# bc_zephyr::ZEPHYR_MAX_DEPTH (80 levels of nesting, up to ~800 bytes each) must fit this stack.
CONFIG_MAIN_STACK_SIZE=98304
```

## boards/qemu_riscv32.conf
```kconfig
# Memory & Heap Configuration for QEMU RISC-V 32 (256MB RAM)
CONFIG_HEAP_MEM_POOL_SIZE=2097152
CONFIG_COMMON_LIBC_MALLOC_ARENA_SIZE=2097152

# Turn a main-stack overflow into a fatal error, so the nesting-limit self-tests detect it.
CONFIG_HW_STACK_PROTECTION=y
```

## boards/stamp_c3.conf
```kconfig
# Memory & Heap Configuration for M5Stamp C3 (ESP32-C3 400KB SRAM)
CONFIG_HEAP_MEM_POOL_SIZE=32768
CONFIG_COMMON_LIBC_MALLOC_ARENA_SIZE=32768

# USB-Serial JTAG Console Driver for M5Stamp C3 Type-C USB (/dev/ttyACM0)
CONFIG_SERIAL_ESP32_USB=y
```

## src/main.c
```c
/*
 * Copyright (c) 2026 Takayuki Nagata
 * SPDX-License-Identifier: MIT
 */

#include <zephyr/kernel.h>
#include <zephyr/sys/printk.h>
#include <zephyr/drivers/uart.h>
#include <stdbool.h>

static const struct device *const console_dev = DEVICE_DT_GET(DT_CHOSEN(zephyr_console));

void zephyr_putc(char c)
{
    printk("%c", c);
}

int zephyr_getchar(void)
{
    if (!console_dev) {
        return -1;
    }
    unsigned char c;
    if (uart_poll_in(console_dev, &c) == 0) {
        return (int)c;
    }
    return -1;
}

void zephyr_msleep(uint32_t ms)
{
    k_msleep(ms);
}

#if defined(CONFIG_BOARD_QEMU_RISCV32) && !defined(CONFIG_BC_QEMU_REPL)
#include <zephyr/fatal.h>

/*
 * A fatal error (for example a stack overflow caught by CONFIG_HW_STACK_PROTECTION) ends the
 * self-test run: exit QEMU with a failure status through the SiFive test device instead of
 * halting, so that CI fails at once rather than hanging.
 */
void k_sys_fatal_error_handler(unsigned int reason, const struct arch_esf *esf)
{
    ARG_UNUSED(esf);
    printk("FATAL ERROR %u: bc_core self-tests aborted\n", reason);
    *(volatile uint32_t *)0x100000 = 0x3333;
    for (;;) {
    }
}
#endif

// Rust application entry point
extern void zephyr_rust_main(bool is_qemu);

int main(void)
{
#if defined(CONFIG_BOARD_QEMU_RISCV32) && !defined(CONFIG_BC_QEMU_REPL)
    zephyr_rust_main(true);
#else
    zephyr_rust_main(false);
#endif
    return 0;
}
```
